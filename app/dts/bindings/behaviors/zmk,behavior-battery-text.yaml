## app/dts/bindings/behaviors/zmk,behavior-battery-text.yaml
```yaml
# Copyright (c) 2025 The ZMK Contributors
# SPDX-License-Identifier: MIT

description: Battery Text Output Behavior - Outputs battery percentages as text

compatible: "zmk,behavior-battery-text"

include: zero_param.yaml
```
